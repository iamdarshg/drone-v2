/**
 * @cliArgs --device "F28P55x" --part "F28P55x_80PNA" --package "80PNA"
 * @versions {"tool":"1.26.1+4441"}
 */

/**
 * These are the peripherals and settings in this configuration
 */
const ANALOG1                                    = scripting.addPeripheral("ANALOG");
ANALOG1.$name                                    = "MyANALOG1";
ANALOG1["A0, B15, C15, DACA_OUT"].$assign        = "A0, B15, C15, DACA_OUT";
ANALOG1["A2, B6, C9, PGA1_INP, GPIO224"].$used   = false;
ANALOG1["A3, B3, PGA2_INP, C5, GPIO242"].$used   = false;
ANALOG1["A4, B8, C14"].$used                     = false;
ANALOG1["A5, B12, C2, PGA2_INM"].$used           = false;
ANALOG1["A6, D14, E14, GPIO228"].$used           = false;
ANALOG1["A7, B30, C3, D12, E30, PGA3_INM"].$used = false;
ANALOG1["A8, B0, C11, PGA3_OUT"].$used           = false;
ANALOG1["A9, B4, C8, GPIO227, GPIO236"].$used    = false;
ANALOG1["A10, B1, C10, GPIO230"].$used           = false;
ANALOG1["A11, B10, C0, PGA2_OUT"].$used          = false;
ANALOG1["A12, C1, E11, PGA3_INP"].$used          = false;
ANALOG1["A14, B14, C4, PGA1_OUT"].$assign        = "A14, B14, C4, PGA1_OUT";
ANALOG1["A15, B9, C7, PGA1_INM"].$assign         = "A15, B9, C7, PGA1_INM";
ANALOG1["A16, B16, C16, GPIO28"].$used           = false;
ANALOG1["A17, B17, C17, GPIO20"].$used           = false;
ANALOG1["A18, B18, C18, GPIO21"].$used           = false;
ANALOG1["A19, B19, C19, GPIO13"].$used           = false;
ANALOG1["A20, B20, C20, GPIO12"].$used           = false;
ANALOG1["A24, D0, E0, GPIO11"].$used             = false;
ANALOG1["A25, D3, E3, GPIO17"].$used             = false;
ANALOG1["B2, C6, E12, GPIO226"].$used            = false;
ANALOG1["B24, D1, E1, GPIO33"].$used             = false;
ANALOG1["B25, D4, E4, GPIO24"].$used             = false;
ANALOG1["C24, D2, E2, GPIO16"].$used             = false;
ANALOG1["D20, E20, VREFHI"].$used                = false;
ANALOG1["A13, B13, C13, D13, E13, VREFLO"].$used = false;
ANALOG1["A1, B7, D11, CMP1_DACL"].$assign        = "A1, B7, D11, CMP1_DACL";
const EPWM1                                      = scripting.addPeripheral("EPWM");
EPWM1.$name                                      = "MyEPWM1";
EPWM1["EPWM#_A"].$assign                         = "GPIO6";
EPWM1["EPWM#_B"].$used                           = false;
const EPWM2                                      = scripting.addPeripheral("EPWM");
EPWM2.$name                                      = "MyEPWM2";
EPWM2["EPWM#_A"].$assign                         = "GPIO10";
EPWM2["EPWM#_B"].$used                           = false;
const EPWM3                                      = scripting.addPeripheral("EPWM");
EPWM3.$name                                      = "MyEPWM3";
EPWM3["EPWM#_A"].$assign                         = "GPIO0";
EPWM3["EPWM#_B"].$used                           = false;
const EPWM4                                      = scripting.addPeripheral("EPWM");
EPWM4.$name                                      = "MyEPWM4";
EPWM4["EPWM#_A"].$assign                         = "GPIO2";
EPWM4["EPWM#_B"].$used                           = false;
const EPWM5                                      = scripting.addPeripheral("EPWM");
EPWM5.$name                                      = "MyEPWM5";
EPWM5["EPWM#_A"].$assign                         = "GPIO4";
EPWM5["EPWM#_B"].$used                           = false;
const EPWM6                                      = scripting.addPeripheral("EPWM");
EPWM6.$name                                      = "MyEPWM6";
EPWM6["EPWM#_A"].$assign                         = "GPIO8";
const GPIO1                                      = scripting.addPeripheral("GPIO");
GPIO1.$name                                      = "MyGPIO1";
GPIO1["GPIO#"].$assign                           = "GPIO30";
const GPIO2                                      = scripting.addPeripheral("GPIO");
GPIO2.$name                                      = "MyGPIO2";
GPIO2["GPIO#"].$assign                           = "GPIO31";
const GPIO3                                      = scripting.addPeripheral("GPIO");
GPIO3.$name                                      = "MyGPIO3";
GPIO3["GPIO#"].$assign                           = "GPIO46";
const GPIO4                                      = scripting.addPeripheral("GPIO");
GPIO4.$name                                      = "MyGPIO4";
GPIO4["GPIO#"].$assign                           = "A6, D14, E14, GPIO228";
const GPIO5                                      = scripting.addPeripheral("GPIO");
GPIO5.$name                                      = "MyGPIO5";
GPIO5["GPIO#"].$assign                           = "B2, C6, E12, GPIO226";
const GPIO6                                      = scripting.addPeripheral("GPIO");
GPIO6.$name                                      = "MyGPIO6";
GPIO6["GPIO#"].$assign                           = "GPIO1";
const GPIO7                                      = scripting.addPeripheral("GPIO");
GPIO7.$name                                      = "MyGPIO7";
GPIO7["GPIO#"].$assign                           = "GPIO34";
const GPIO8                                      = scripting.addPeripheral("GPIO");
GPIO8.$name                                      = "MyGPIO8";
GPIO8["GPIO#"].$assign                           = "GPIO3";
const GPIO9                                      = scripting.addPeripheral("GPIO");
GPIO9.$name                                      = "MyGPIO9";
GPIO9["GPIO#"].$assign                           = "GPIO15";
const GPIO10                                     = scripting.addPeripheral("GPIO");
GPIO10.$name                                     = "MyGPIO10";
GPIO10["GPIO#"].$assign                          = "GPIO14";
const GPIO11                                     = scripting.addPeripheral("GPIO");
GPIO11.$name                                     = "MyGPIO11";
GPIO11["GPIO#"].$assign                          = "GPIO40";
const GPIO12                                     = scripting.addPeripheral("GPIO");
GPIO12.$name                                     = "MyGPIO12";
GPIO12["GPIO#"].$assign                          = "GPIO22";
const GPIO13                                     = scripting.addPeripheral("GPIO");
GPIO13.$name                                     = "MyGPIO13";
GPIO13["GPIO#"].$assign                          = "GPIO7";
const GPIO14                                     = scripting.addPeripheral("GPIO");
GPIO14.$name                                     = "MyGPIO14";
GPIO14["GPIO#"].$assign                          = "GPIO44";
const GPIO15                                     = scripting.addPeripheral("GPIO");
GPIO15.$name                                     = "MyGPIO15";
GPIO15["GPIO#"].$assign                          = "GPIO45";
const GPIO16                                     = scripting.addPeripheral("GPIO");
GPIO16.$name                                     = "MyGPIO16";
GPIO16["GPIO#"].$assign                          = "GPIO5";
const GPIO17                                     = scripting.addPeripheral("GPIO");
GPIO17.$name                                     = "MyGPIO17";
GPIO17["GPIO#"].$assign                          = "GPIO9";
const GPIO18                                     = scripting.addPeripheral("GPIO");
GPIO18.$name                                     = "MyGPIO18";
GPIO18["GPIO#"].$assign                          = "GPIO43";
const GPIO19                                     = scripting.addPeripheral("GPIO");
GPIO19.$name                                     = "MyGPIO19";
GPIO19["GPIO#"].$assign                          = "B25, D4, E4, GPIO24";
const GPIO20                                     = scripting.addPeripheral("GPIO");
GPIO20.$name                                     = "MyGPIO20";
GPIO20["GPIO#"].$assign                          = "A18, B18, C18, GPIO21";
const GPIO21                                     = scripting.addPeripheral("GPIO");
GPIO21.$name                                     = "MyGPIO21";
GPIO21["GPIO#"].$assign                          = "A17, B17, C17, GPIO20";
const GPIO22                                     = scripting.addPeripheral("GPIO");
GPIO22.$name                                     = "MyGPIO22";
GPIO22["GPIO#"].$assign                          = "GPIO63";
const GPIO23                                     = scripting.addPeripheral("GPIO");
GPIO23.$name                                     = "MyGPIO23";
GPIO23["GPIO#"].$assign                          = "GPIO62";
const GPIO24                                     = scripting.addPeripheral("GPIO");
GPIO24.$name                                     = "MyGPIO24";
GPIO24["GPIO#"].$assign                          = "A9, B4, C8, GPIO227, GPIO236";
const GPIO25                                     = scripting.addPeripheral("GPIO");
GPIO25.$name                                     = "MyGPIO25";
const GPIO26                                     = scripting.addPeripheral("GPIO");
GPIO26.$name                                     = "MyGPIO26";
const I2C1                                       = scripting.addPeripheral("I2C");
I2C1.$name                                       = "MyI2C1";
I2C1["I2C@_SDA"].$assign                         = "GPIO32";
I2C1["I2C@_SCL"].$assign                         = "B24, D1, E1, GPIO33";
const MCAN1                                      = scripting.addPeripheral("MCAN");
MCAN1.$name                                      = "MyMCAN1";
MCAN1["MCAN@_RX"].$assign                        = "A20, B20, C20, GPIO12";
MCAN1["MCAN@_TX"].$assign                        = "A19, B19, C19, GPIO13";
const OUTPUTXBAR1                                = scripting.addPeripheral("OUTPUTXBAR");
OUTPUTXBAR1.$name                                = "MyOUTPUTXBAR1";
OUTPUTXBAR1["OUTPUTXBAR#"].$assign               = "GPIO25";
const OUTPUTXBAR2                                = scripting.addPeripheral("OUTPUTXBAR");
OUTPUTXBAR2.$name                                = "MyOUTPUTXBAR2";
OUTPUTXBAR2["OUTPUTXBAR#"].$assign               = "GPIO26";
const OUTPUTXBAR3                                = scripting.addPeripheral("OUTPUTXBAR");
OUTPUTXBAR3.$name                                = "MyOUTPUTXBAR3";
OUTPUTXBAR3["OUTPUTXBAR#"].$assign               = "GPIO27";
const OUTPUTXBAR4                                = scripting.addPeripheral("OUTPUTXBAR");
OUTPUTXBAR4.$name                                = "MyOUTPUTXBAR4";
OUTPUTXBAR4["OUTPUTXBAR#"].$assign               = "A24, D0, E0, GPIO11";
const SCI1                                       = scripting.addPeripheral("SCI");
SCI1.$name                                       = "MySCI1";
SCI1["SCI@_RX"].$assign                          = "A16, B16, C16, GPIO28";
SCI1["SCI@_TX"].$assign                          = "GPIO29";
const SPI1                                       = scripting.addPeripheral("SPI");
SPI1.$name                                       = "MySPI1";
SPI1["SPI@_PICO"].$assign                        = "C24, D2, E2, GPIO16";
SPI1["SPI@_POCI"].$assign                        = "A25, D3, E3, GPIO17";
SPI1["SPI@_POCI"].$used                          = true;
SPI1["SPI@_CLK"].$assign                         = "GPIO18, X2";
SPI1["SPI@_PTE"].$assign                         = "GPIO19, X1";
const USB1                                       = scripting.addPeripheral("USB");
USB1.$name                                       = "MyUSB1";

/**
 * Pinmux solution for unlocked pins/peripherals. This ensures that minor changes to the automatic solver in a future
 * version of the tool will not impact the pinmux you originally saw.  These lines can be completely deleted in order to
 * re-solve from scratch.
 */
ANALOG1.$suggestSolution          = "ANALOG";
EPWM1.$suggestSolution            = "EPWM2";
EPWM2.$suggestSolution            = "EPWM6";
EPWM3.$suggestSolution            = "EPWM1";
EPWM4.$suggestSolution            = "EPWM10";
EPWM5.$suggestSolution            = "EPWM3";
EPWM6.$suggestSolution            = "EPWM5";
EPWM6["EPWM#_B"].$suggestSolution = "GPIO35/TDI";
GPIO1.$suggestSolution            = "GPIO30";
GPIO2.$suggestSolution            = "GPIO31";
GPIO3.$suggestSolution            = "GPIO46";
GPIO4.$suggestSolution            = "GPIO228";
GPIO5.$suggestSolution            = "GPIO226";
GPIO6.$suggestSolution            = "GPIO1";
GPIO7.$suggestSolution            = "GPIO34";
GPIO8.$suggestSolution            = "GPIO3";
GPIO9.$suggestSolution            = "GPIO15";
GPIO10.$suggestSolution           = "GPIO14";
GPIO11.$suggestSolution           = "GPIO40";
GPIO12.$suggestSolution           = "GPIO22";
GPIO13.$suggestSolution           = "GPIO7";
GPIO14.$suggestSolution           = "GPIO44";
GPIO15.$suggestSolution           = "GPIO45";
GPIO16.$suggestSolution           = "GPIO5";
GPIO17.$suggestSolution           = "GPIO9";
GPIO18.$suggestSolution           = "GPIO43";
GPIO19.$suggestSolution           = "GPIO24";
GPIO20.$suggestSolution           = "GPIO21";
GPIO21.$suggestSolution           = "GPIO20";
GPIO22.$suggestSolution           = "GPIO63";
GPIO23.$suggestSolution           = "GPIO62";
GPIO24.$suggestSolution           = "GPIO227";
GPIO25.$suggestSolution           = "GPIO42";
GPIO25["GPIO#"].$suggestSolution  = "GPIO42";
GPIO26.$suggestSolution           = "GPIO37";
GPIO26["GPIO#"].$suggestSolution  = "GPIO37/TDO";
I2C1.$suggestSolution             = "I2CA";
MCAN1.$suggestSolution            = "MCANA";
OUTPUTXBAR1.$suggestSolution      = "OUTPUTXBAR2";
OUTPUTXBAR2.$suggestSolution      = "OUTPUTXBAR3";
OUTPUTXBAR3.$suggestSolution      = "OUTPUTXBAR4";
OUTPUTXBAR4.$suggestSolution      = "OUTPUTXBAR7";
SCI1.$suggestSolution             = "SCIA";
SPI1.$suggestSolution             = "SPIA";
USB1.$suggestSolution             = "USB0";
USB1["USB#DM"].$suggestSolution   = "GPIO23";
USB1["USB#DP"].$suggestSolution   = "GPIO41";
